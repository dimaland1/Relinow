## examples/benchmark_rust/sdkconfig.defaults
```kconfig
CONFIG_WIFI_ENABLED=y
CONFIG_ESP_WIFI_ENABLED=y
CONFIG_ESP_WIFI_STATIC_RX_BUFFER_NUM=10
CONFIG_ESP_WIFI_DYNAMIC_RX_BUFFER_NUM=32
CONFIG_ESP_WIFI_DYNAMIC_TX_BUFFER_NUM=32
CONFIG_ESP_WIFI_AMPDU_TX_ENABLED=y
CONFIG_ESP_WIFI_AMPDU_RX_ENABLED=y
CONFIG_ESP_WIFI_NVS_ENABLED=n

CONFIG_ESPNOW_MAX_ENCRYPT_PEER_NUM=0
CONFIG_ESP_WIFI_ESPNOW_MAX_ENCRYPT_PEER_NUM=0
```
